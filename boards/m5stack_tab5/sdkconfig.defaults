## components/emu/Kconfig
```kconfig
menu "Emulator board"

    config EMU_WIFI
        bool "WiFi"
        default y
        help
            Connect to WiFi (stays connected while the machine runs) and set
            the clock from the internet; the machine's clock follows it.

    config EMU_HOSTNAME
        string "Network name of the board"
        depends on EMU_WIFI
        default "esp32emu"
        help
            Announced over mDNS (<name>.local) and DHCP.

    config EMU_TIMEZONE
        string "Time zone (POSIX TZ)"
        depends on EMU_WIFI
        default "CET-1CEST,M3.5.0,M10.5.0/3"
        help
            Local time rules, e.g. "CET-1CEST,M3.5.0,M10.5.0/3" for Central
            Europe or "GMT0BST,M3.5.0/1,M10.5.0" for the UK.

    config EMU_WEB
        bool "Web page for disk images"
        depends on EMU_WIFI
        default y
        help
            A web server on the board (http://<hostname>.local) to upload
            disk images from a computer (drag and drop, .ZIP files are
            unpacked), put them into drives, download and delete them, and
            see the machine and the board live. Also for scripts:
            curl -T game.img http://<hostname>.local/disks/

    config EMU_SETUP_SCREEN
        bool "Setup screen before the machine starts"
        depends on EMU_WIFI
        default y
        help
            Touch screen for WiFi, Bluetooth, disks and the machine's
            settings. Hold the top-right corner for 2 s to come back to it.

    config EMU_AUTOSTART
        bool "Start the machine by itself"
        depends on EMU_SETUP_SCREEN
        default n
        help
            Leave the setup screen after a countdown once the time is known
            (or without WiFi set up), for boards nobody is watching.

    config EMU_AUTOSTART_SECONDS
        int "Countdown (seconds)"
        depends on EMU_AUTOSTART
        range 1 60
        default 5

    config EMU_BLE_HID
        bool "BLE keyboard and mouse"
        default y
        depends on BT_NIMBLE_ENABLED
        help
            Connect a Bluetooth LE keyboard and mouse as the machine's.
            New devices pair when put into pairing mode.

    config EMU_USB_HID
        bool "USB keyboard and mouse (Tab5)"
        default y
        depends on IDF_TARGET_ESP32P4
        help
            Keyboards and mice on the Tab5's USB-A port (boot protocol), as
            the machine's, besides Bluetooth ones.

    config EMU_MOUSE_DIVIDER
        int "Mouse speed divider"
        depends on EMU_BLE_HID
        range 1 8
        default 2
        help
            BLE mouse motion is divided by this before it reaches the
            machine. Higher is slower.

    config EMU_SPEAKER
        bool "Sound on the board speaker"
        default y if IDF_TARGET_ESP32P4
        default n
        help
            Play the machine's sound through the board's speaker.
            MaTouch: the onboard MAX98357A amplifier. Its I2S pins are
            shared with the native USB port (GPIO19/20), so that port stops
            working once the machine starts: the console (logs,
            tools/emu_console.py) moves to the USB-to-UART port at 921600
            baud, and flashing goes through that port too.
            Tab5: the ES8388 codec and its amplifier; the USB port stays.

    config EMU_SPEAKER_VOLUME
        int "Speaker volume (%)"
        depends on EMU_SPEAKER
        range 0 100
        default 60

endmenu
```

## components/musashi/Kconfig
```kconfig
menu "68000 core (Musashi)"

    choice M68K_CPU
        prompt "CPU"
        default M68K_68000
        help
            The machine's CPU, fixed at compile time. The project's
            sdkconfig.defaults sets it.

        config M68K_68000
            bool "68000 (Atari ST, compact Macintosh)"
        config M68K_68020
            bool "68020 (Macintosh LC and II)"
        config M68K_68030
            bool "68030 with its MMU (Macintosh LC II and LC III)"
    endchoice

endmenu
```

## components/z80/Kconfig
```kconfig
menu "Z80 core"

    choice Z80_TIMING
        prompt "Instruction times"
        default Z80_TIMING_TSTATES
        help
            What z80_step() counts in.

        config Z80_TIMING_TSTATES
            bool "T-states"
        config Z80_TIMING_CPC
            bool "Amstrad CPC microseconds"
            help
                The Gate Array stretches every memory and I/O access to a
                1 us grid: each instruction takes a whole number of them.
    endchoice

    config Z80_READ_SPECIAL
        bool "Reads from unmapped banks through the machine"
        default n
        help
            A NULL read bank goes to the bus's read_special() (the
            Commodore 128's MMU maps by the page). Costs a test per read.

    config Z80_MSX
        bool "MSX memory: 8 KB banks and the slot register at $FFFF"
        default n
        select Z80_READ_SPECIAL
        help
            Eight 8 KB banks instead of four of 16 KB (MSX cartridges and
            disk interfaces map 8 KB at a time), and while z80_ffff_special
            is set, reads and writes of $FFFF (an expanded slot's
            secondary slot register) go to the bus's read_special() and
            write_special(). Costs a compare per access.

    config Z80_CONTENTION
        bool "Memory contention (ZX Spectrum)"
        depends on Z80_TIMING_TSTATES && !Z80_MSX
        default n
        help
            Memory accesses to contended 16 KB banks wait as long as the
            machine's table says for that moment (z80_contention).

endmenu
```
